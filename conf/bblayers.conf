## conf/bblayers.conf
```bitbake
# POKY_BBLAYERS_CONF_VERSION is increased each time build/conf/bblayers.conf
# changes incompatibly
POKY_BBLAYERS_CONF_VERSION = "2"

BBPATH = "${TOPDIR}"
BBFILES ?= ""

BBLAYERS ?= " \
  poky/meta \
  poky/meta-poky \
  poky/meta-yocto-bsp \
  poky/meta-openembedded/meta-oe \
  poky/meta-openembedded/meta-python \
  poky/meta-toradex-bsp-common \
  poky/meta-freescale \
  poky/meta-freescale-3rdparty \
  poky/meta-toradex-nxp \
  poky/meta-qt5 \
  poky/meta-mender/meta-mender-core \
  poky/meta-mender/meta-mender-toradex-nxp \
  poky/meta-hosted-mender-login \
  "
```
